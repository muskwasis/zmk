## app/boards/shields/torne/Kconfig.defconfig
```kconfig
if SHIELD_TORNE_LEFT
config ZMK_KEYBOARD_NAME
    default "torne"
endif
config ZMK_SPLIT_ROLE_CENTRAL
    default y
endif

if SHIELD_TORNE_LEFT || SHIELD_TORNE_RIGHT
config ZMK_SPLIT
    default y
endif
```

## app/boards/shields/torne/Kconfig.shield
```kconfig
config SHIELD_TORNE_LEFT
    def_bool $(shields_list_contains,torne_left)

config SHIELD_TORNE_RIGHT
    def_bool $(shields_list_contains,torne_right)
```
